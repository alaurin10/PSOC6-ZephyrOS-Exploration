## apps/sound_dashboard/ext/Kconfig
```kconfig
# SPDX-License-Identifier: Apache-2.0

menu "Sound dashboard PSoC 6 drivers"

rsource "drivers/Kconfig"

endmenu
```

## apps/sound_dashboard/ext/drivers/audio/Kconfig
```kconfig
# SPDX-License-Identifier: Apache-2.0

config AUDIO_DMIC_PSOC6_PDM
	bool "PSoC 6 (CAT1A) PDM-to-PCM converter"
	default y
	depends on DT_HAS_INFINEON_CAT1A_PDM_ENABLED
	depends on AUDIO_DMIC
	select PINCTRL
	help
	  DMIC driver for the PDM-PCM v1 block in the PSoC 6 audio subsystem.

if AUDIO_DMIC_PSOC6_PDM

config DMIC_PSOC6_PDM_QUEUE_SIZE
	int "Receive queue length"
	default 8
	help
	  Filled blocks waiting for dmic_read(). Should match the number of
	  blocks in the application's memory slab.

# Kconfig splits macro arguments on commas, so pass the compatible through a variable.
DT_COMPAT_INFINEON_CAT1A_PDM := infineon,cat1a-pdm

config DMIC_PSOC6_PDM_DMA
	bool "Move samples with DMA"
	default y
	depends on $(dt_compat_any_has_prop,$(DT_COMPAT_INFINEON_CAT1A_PDM),dmas)
	select USE_INFINEON_DMA
	help
	  A DataWire channel copies the samples from the PDM FIFO into the
	  application's buffers, ping-ponging between two of them, so the CPU
	  only runs once per block instead of every 128 samples. The block size
	  must split into DMA bursts: (samples per block) = burst x count with
	  burst <= 128 and count <= 256.

endif # AUDIO_DMIC_PSOC6_PDM
```

## apps/sound_dashboard/ext/drivers/flash/Kconfig
```kconfig
# SPDX-License-Identifier: Apache-2.0

config FLASH_PSOC6_SMIF
	bool "PSoC 6 (CAT1A) SMIF serial NOR flash"
	default y
	depends on DT_HAS_INFINEON_CAT1A_SMIF_NOR_ENABLED
	depends on FLASH
	select FLASH_HAS_DRIVER_ENABLED
	select FLASH_HAS_PAGE_LAYOUT
	select FLASH_HAS_EXPLICIT_ERASE
	select USE_INFINEON_SMIF
	select PINCTRL
	help
	  Flash API driver for a serial NOR memory on the SMIF. The memory's
	  geometry and commands are read from its SFDP tables at boot.
```

## apps/sound_dashboard/ext/dts/bindings/audio/infineon,cat1a-pdm.yaml
```yaml
# SPDX-License-Identifier: Apache-2.0

description: |
  PSoC 6 (CAT1A) AUDIOSS PDM-to-PCM converter (the "PDM-PCM v1" block),
  exposed through the Zephyr DMIC API.

  Zephyr's own "infineon,pdm" driver is for the newer PDM-PCM v2 block (PSOC
  Edge), which has a different register layout.

  The converter takes one PDM data line carrying a left and a right
  microphone (selected by each microphone's L/R pin) and outputs mono-left,
  mono-right or interleaved stereo PCM.

  Without "dmas" the driver empties the hardware FIFO from its interrupt.
  With "dmas" (and CONFIG_DMIC_PSOC6_PDM_DMA) a DataWire channel moves the
  samples straight into the application's buffers, ping-ponging between two
  of them, and the CPU only runs once per finished buffer. On PSoC 6 the
  PDM's DMA request is wired one-to-one to DataWire 1 channel 26.

  Example:

    pdm0: pdm@40a00000 {
      compatible = "infineon,cat1a-pdm";
      reg = <0x40a00000 0x1000>;
      interrupts = <157 6>;
      clocks = <&clk_hf1>;
      dmas = <&dma1 26>;
      dma-names = "rx";
      pinctrl-0 = <&p10_4_pdm_clk &p10_5_pdm_data>;
      pinctrl-names = "default";
    };

compatible: "infineon,cat1a-pdm"

include: [base.yaml, pinctrl-device.yaml]

properties:
  reg:
    required: true

  interrupts:
    required: true

  clocks:
    required: true
    description: |
      The high-frequency clock feeding the audio subsystem. On PSoC 6 this is
      always clk_hf1; pick its frequency so the PDM clock (sample rate x
      decimation rate) divides it evenly, e.g. 24.576 MHz for 8/16/32/48 kHz.

  pinctrl-0:
    required: true

  pinctrl-names:
    required: true

  dmas:
    description: |
      Optional DataWire channel for the receive FIFO. Must be <&dma1 26>.
      The dma1 node itself stays disabled: this driver programs the channel
      directly, because Zephyr's DataWire driver can't run an endless
      ping-pong chain.

  dma-names:
    description: Must be "rx" when dmas is set.

  decimation-rate:
    type: int
    default: 64
    description: |
      PDM clock cycles per PCM sample (oversampling ratio). The PDM clock
      on the microphone pin is sample rate x decimation rate, e.g.
      16 kHz x 64 = 1.024 MHz. Even, 16 to 254.

  high-pass-gain:
    type: int
    default: 8
    description: |
      Corner of the DC-blocking high-pass filter:
      H(z) = (1 - z^-1) / (1 - (1 - 2^-gain) z^-1). Larger = lower corner.
      0 to 15.

  cko-delay:
    type: int
    default: 0
    enum: [0, 1, 2, 3, 4, 5, 6, 7]
    description: |
      When the converter samples the data line relative to the PDM clock
      edge: 0 = three PDM_CLK periods early ... 3 = no delay ... 7 = four
      periods late. Only needs changing if the microphones' data-valid
      timing doesn't fit the default.
```

## apps/sound_dashboard/ext/dts/bindings/mtd/infineon,cat1a-smif-nor.yaml
```yaml
# SPDX-License-Identifier: Apache-2.0

description: |
  Serial NOR flash on the PSoC 6 (CAT1A) SMIF (serial memory interface),
  exposed through the Zephyr flash API.

  The driver asks the memory for its own description (SFDP, JESD216) at
  boot: commands, address width, erase and page sizes, and whether it can
  read over four data lines. So any SFDP-capable NOR works without a
  hand-written memory configuration; the devicetree only says where it is.

  The SMIF is clocked by clk_hf2 on PSoC 6.

  Zephyr's "infineon,qspi-flash" driver needs a memory configuration from
  the board and leaves the pins to vendor startup code, which PSoC 6 boards
  in Zephyr don't have.

  Example (CY8CPROTO-062-4343W: 64 MB S25FL512S on slave select 0 and data
  lines 0-3):

    qspi_flash: qspi-flash@40420000 {
      compatible = "infineon,cat1a-smif-nor";
      reg = <0x40420000 0x10000>;
      clocks = <&clk_hf2>;
      pinctrl-0 = <&p11_2_smif_ss0 &p11_3_smif_d3 &p11_4_smif_d2
                   &p11_5_smif_d1 &p11_6_smif_d0 &p11_7_smif_clk>;
      pinctrl-names = "default";
      flash-size = <0x4000000>;

      partitions {
        compatible = "fixed-partitions";
        #address-cells = <1>;
        #size-cells = <1>;

        log_partition: partition@0 {
          label = "log";
          reg = <0x0 0x1000000>;
        };
      };
    };

compatible: "infineon,cat1a-smif-nor"

include: [base.yaml, pinctrl-device.yaml]

properties:
  reg:
    required: true

  clocks:
    required: true
    description: The SMIF's clock, clk_hf2 on PSoC 6.

  pinctrl-0:
    required: true

  pinctrl-names:
    required: true

  flash-size:
    type: int
    required: true
    description: |
      Bytes of the memory the flash API exposes. Must not exceed what the
      memory reports through SFDP (checked at boot).

  slave-select:
    type: int
    default: 0
    enum: [0, 1, 2, 3]
    description: SMIF chip select line the memory is on (spi_select0..3).

  data-select:
    type: int
    default: 0
    enum: [0, 1, 2, 3]
    description: |
      SMIF data lines the memory is on: 0 = data0-3, 1 = data2-5 (dual
      SPI only), 2 = data4-7, 3 = data6-7 (dual SPI only).

  quad-enable:
    type: boolean
    description: |
      Allow the driver to set the memory's non-volatile Quad Enable bit if
      the commands the memory reports need four data lines and the bit isn't
      set yet. Without this property the driver uses one data line in that
      case.
```

## apps/sound_dashboard/tests/dsp/testcase.yaml
```yaml
tests:
  sound_dashboard.dsp:
    tags: dsp
    platform_allow:
      - cy8cproto_062_4343w
      - mps2/an386
      - qemu_cortex_m3
      - qemu_cortex_m0
    integration_platforms:
      - mps2/an386
```
